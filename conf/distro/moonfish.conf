## conf/distro/moonfish.conf
```bitbake
DISTRO_NAME = "moonfish"
DISTRO_CODENAME = "master"
DISTRO_VERSION = "${DISTRO_CODENAME}-${DISTRO_NAME}"

PACKAGE_CLASSES = "package_rpm"

INIT_MANAGER = "sysvinit"
```
